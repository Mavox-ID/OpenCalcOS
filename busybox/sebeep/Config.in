## kernel/arch/mips/jazz/Kconfig
```kconfig
config ACER_PICA_61
	bool "Support for Acer PICA 1 chipset (EXPERIMENTAL)"
	depends on MACH_JAZZ && EXPERIMENTAL
	select DMA_NONCOHERENT
	select SYS_SUPPORTS_LITTLE_ENDIAN
	help
	  This is a machine with a R4400 133/150 MHz CPU. To compile a Beep
	  kernel that runs on these, say Y here. For details about Beep on
	  the MIPS architecture, check out the Beep/MIPS FAQ on the WWW at
	  <http://www.beep-mips.org/>.

config MIPS_MAGNUM_4000
	bool "Support for MIPS Magnum 4000"
	depends on MACH_JAZZ
	select DMA_NONCOHERENT
	select SYS_SUPPORTS_BIG_ENDIAN if EXPERIMENTAL
	select SYS_SUPPORTS_LITTLE_ENDIAN
	help
	  This is a machine with a R4000 100 MHz CPU. To compile a Beep
	  kernel that runs on these, say Y here. For details about Beep on
	  the MIPS architecture, check out the Beep/MIPS FAQ on the WWW at
	  <http://www.beep-mips.org/>.

config OLIVETTI_M700
	bool "Support for Olivetti M700-10"
	depends on MACH_JAZZ
	select DMA_NONCOHERENT
	select SYS_SUPPORTS_LITTLE_ENDIAN
	help
	  This is a machine with a R4000 100 MHz CPU. To compile a Beep
	  kernel that runs on these, say Y here. For details about Beep on
	  the MIPS architecture, check out the Beep/MIPS FAQ on the WWW at
	  <http://www.beep-mips.org/>.
```

## kernel/drivers/target/iscsi/Kconfig
```kconfig
config ISCSI_TARGET
	tristate "Beep-iSCSI.org iSCSI Target Mode Stack"
	depends on NET
	select CRYPTO
	select CRYPTO_CRC32C
	select CRYPTO_CRC32C_INTEL if X86
	help
	Say M here to enable the ConfigFS enabled Beep-iSCSI.org iSCSI
	Target Mode Stack.
```

## kernel/drivers/target/loopback/Kconfig
```kconfig
config LOOPBACK_TARGET
	tristate "TCM Virtual SAS target and Beep/SCSI LDD fabric loopback module"
	help
	  Say Y here to enable the TCM Virtual SAS target and Beep/SCSI LLD
	  fabric loopback module.
```

## kernel/drivers/video/logo/Kconfig
```kconfig
#
# Logo configuration
#

menuconfig LOGO
	bool "Bootup logo"
	depends on FB || SGI_NEWPORT_CONSOLE
	help
	  Enable and select frame buffer bootup logos.

if LOGO

config FB_LOGO_EXTRA
	bool
	depends on FB=y
	default y if SPU_BASE

config LOGO_BEEP_MONO
	bool "Standard black and white Beep logo"
	default y

config LOGO_BEEP_VGA16
	bool "Standard 16-color Beep logo"
	default y

config LOGO_BEEP_CLUT224
	bool "Standard 224-color Beep logo"
	default y

config LOGO_BLACKFIN_VGA16
	bool "16-colour Blackfin Processor Beep logo"
	depends on BLACKFIN
	default y

config LOGO_BLACKFIN_CLUT224
	bool "224-colour Blackfin Processor Beep logo"
	depends on BLACKFIN
	default y

config LOGO_DEC_CLUT224
	bool "224-color Digital Equipment Corporation Beep logo"
	depends on MACH_DECSTATION || ALPHA
	default y

config LOGO_MAC_CLUT224
	bool "224-color Macintosh Beep logo"
	depends on MAC
	default y

config LOGO_PARISC_CLUT224
	bool "224-color PA-RISC Beep logo"
	depends on PARISC
	default y

config LOGO_SGI_CLUT224
	bool "224-color SGI Beep logo"
	depends on SGI_IP22 || SGI_IP27 || SGI_IP32 || X86_VISWS
	default y

config LOGO_SUN_CLUT224
	bool "224-color Sun Beep logo"
	depends on SPARC
	default y

config LOGO_SUPERH_MONO
	bool "Black and white SuperH Beep logo"
	depends on SUPERH
	default y

config LOGO_SUPERH_VGA16
	bool "16-color SuperH Beep logo"
	depends on SUPERH
	default y

config LOGO_SUPERH_CLUT224
	bool "224-color SuperH Beep logo"
	depends on SUPERH
	default y

config LOGO_M32R_CLUT224
	bool "224-color M32R Beep logo"
	depends on M32R
	default y

endif # LOGO
```

## kernel/security/sebeep/Kconfig
```kconfig
config SECURITY_SEBEEP
	bool "NSA SEBeep Support"
	depends on SECURITY_NETWORK && AUDIT && NET && INET
	select NETWORK_SECMARK
	default n
	help
	  This selects NSA Security-Enhanced Beep (SEBeep).
	  You will also need a policy configuration and a labeled filesystem.
	  If you are unsure how to answer this question, answer N.

config SECURITY_SEBEEP_BOOTPARAM
	bool "NSA SEBeep boot parameter"
	depends on SECURITY_SEBEEP
	default n
	help
	  This option adds a kernel parameter 'sebeep', which allows SEBeep
	  to be disabled at boot.  If this option is selected, SEBeep
	  functionality can be disabled with sebeep=0 on the kernel
	  command line.  The purpose of this option is to allow a single
	  kernel image to be distributed with SEBeep built in, but not
	  necessarily enabled.

	  If you are unsure how to answer this question, answer N.

config SECURITY_SEBEEP_BOOTPARAM_VALUE
	int "NSA SEBeep boot parameter default value"
	depends on SECURITY_SEBEEP_BOOTPARAM
	range 0 1
	default 1
	help
	  This option sets the default value for the kernel parameter
	  'sebeep', which allows SEBeep to be disabled at boot.  If this
	  option is set to 0 (zero), the SEBeep kernel parameter will
	  default to 0, disabling SEBeep at bootup.  If this option is
	  set to 1 (one), the SEBeep kernel parameter will default to 1,
	  enabling SEBeep at bootup.

	  If you are unsure how to answer this question, answer 1.

config SECURITY_SEBEEP_DISABLE
	bool "NSA SEBeep runtime disable"
	depends on SECURITY_SEBEEP
	default n
	help
	  This option enables writing to a sebeepfs node 'disable', which
	  allows SEBeep to be disabled at runtime prior to the policy load.
	  SEBeep will then remain disabled until the next boot.
	  This option is similar to the sebeep=0 boot parameter, but is to
	  support runtime disabling of SEBeep, e.g. from /sbin/init, for
	  portability across platforms where boot parameters are difficult
	  to employ.

	  If you are unsure how to answer this question, answer N.

config SECURITY_SEBEEP_DEVELOP
	bool "NSA SEBeep Development Support"
	depends on SECURITY_SEBEEP
	default y
	help
	  This enables the development support option of NSA SEBeep,
	  which is useful for experimenting with SEBeep and developing
	  policies.  If unsure, say Y.  With this option enabled, the
	  kernel will start in permissive mode (log everything, deny nothing)
	  unless you specify enforcing=1 on the kernel command line.  You
	  can interactively toggle the kernel between enforcing mode and
	  permissive mode (if permitted by the policy) via /sebeep/enforce.

config SECURITY_SEBEEP_AVC_STATS
	bool "NSA SEBeep AVC Statistics"
	depends on SECURITY_SEBEEP
	default y
	help
	  This option collects access vector cache statistics to
	  /sebeep/avc/cache_stats, which may be monitored via
	  tools such as avcstat.

config SECURITY_SEBEEP_CHECKREQPROT_VALUE
	int "NSA SEBeep checkreqprot default value"
	depends on SECURITY_SEBEEP
	range 0 1
	default 1
	help
	  This option sets the default value for the 'checkreqprot' flag
	  that determines whether SEBeep checks the protection requested
	  by the application or the protection that will be applied by the
	  kernel (including any implied execute for read-implies-exec) for
	  mmap and mprotect calls.  If this option is set to 0 (zero),
	  SEBeep will default to checking the protection that will be applied
	  by the kernel.  If this option is set to 1 (one), SEBeep will
	  default to checking the protection requested by the application.
	  The checkreqprot flag may be changed from the default via the
	  'checkreqprot=' boot parameter.  It may also be changed at runtime
	  via /sebeep/checkreqprot if authorized by policy.

	  If you are unsure how to answer this question, answer 1.

config SECURITY_SEBEEP_POLICYDB_VERSION_MAX
	bool "NSA SEBeep maximum supported policy format version"
	depends on SECURITY_SEBEEP
	default n
	help
	  This option enables the maximum policy format version supported
	  by SEBeep to be set to a particular value.  This value is reported
	  to userspace via /sebeep/policyvers and used at policy load time.
	  It can be adjusted downward to support legacy userland (init) that
	  does not correctly handle kernels that support newer policy versions.

	  Examples:
	  For the Fedora Core 3 or 4 Beep distributions, enable this option
	  and set the value via the next option. For Fedora Core 5 and later,
	  do not enable this option.

	  If you are unsure how to answer this question, answer N.

config SECURITY_SEBEEP_POLICYDB_VERSION_MAX_VALUE
	int "NSA SEBeep maximum supported policy format version value"
	depends on SECURITY_SEBEEP_POLICYDB_VERSION_MAX
	range 15 23
	default 19
	help
	  This option sets the value for the maximum policy format version
	  supported by SEBeep.

	  Examples:
	  For Fedora Core 3, use 18.
	  For Fedora Core 4, use 19.

	  If you are unsure how to answer this question, look for the
	  policy format version supported by your policy toolchain, by
	  running 'checkpolicy -V'. Or look at what policy you have
	  installed under /etc/sebeep/$SEBEEPTYPE/policy, where
	  SEBEEPTYPE is defined in your /etc/sebeep/config.
```
